#include <Arduino.h>
#include <Adafruit_GFX.h>
#include <Adafruit_SSD1306.h>
#include <SPI.h>
#include <Wire.h>
#include <NewPing.h>
#include <DallasTemperature.h>
#include "Fonts/TomThumb.h"

#include <HttpClient.h>
#include <ArduinoJson.h>
#include <WiFi.h>

void sendPostRequest(int batt, int distanceThresh1, int distanceThresh2);
void startDisplay();
void initWiFi();
void searchWiFi();
void soundLeftErr();
void soundRightErr();
void goSleep();
void getValue();
int adcAverage(int batteryPin, int read);
float adcToVolts(int batteryPin);
float voltToBatteryPercent(float voltage, float in_min, float in_max, float out_min, float out_max);
int getThreshold(float distance);
void dummy();


#define ONE_WIRE_BUS 0
OneWire oneWire(ONE_WIRE_BUS);
DallasTemperature sensors(&oneWire);


#define ultraTrig1 17
#define ultraEcho1 5
#define ultraTrig2 18
#define ultraEcho2 19

#define BUTTON_PIN_1 14
#define BUTTON_PIN_2 27

#define ADC_PIN 26
#define CONV_FACTOR 1.75

#define MAX_DISTANCE 33

NewPing sonar[2] = {
    NewPing(ultraTrig1, ultraEcho1),
    NewPing(ultraTrig2, ultraEcho2)
};


#define BUZZZER_PIN 33

#define OLED_RESET -1
#define SCREEN_WIDTH 128 // OLED display width, in pixels
#define SCREEN_HEIGHT 64 // OLED display height, in pixels
#define SCREEN_ADDRESS 0x3C
Adafruit_SSD1306 display(SCREEN_WIDTH, SCREEN_HEIGHT, &Wire, OLED_RESET);

HttpClient *http;
WiFiClient wifi;


const char *ssid = "pla1iwg1v";
const char *password = "09104208692";

String path = "/update_data";
String server = "etaponcloud.azurewebsites.net";
int port = 80;

String name = "Cloudbin_ITECH3";

const unsigned char trashbin[] = {
    0x00, 0x00, 0x00, 0x00, 0x00, 0x00, 0x00, 0x00, 0x00, 0x00, 0x00, 0x00, 0x00, 0x00, 0x00, 0x00,
    0x00, 0x01, 0xC0, 0x00, 0x00, 0x00, 0x00, 0x00, 0x00, 0x00, 0x00, 0x00, 0x00, 0x00, 0x00, 0x00,
    0x00, 0x03, 0xF0, 0x00, 0x00, 0x00, 0x00, 0x00, 0x00, 0x00, 0x00, 0x00, 0x00, 0x00, 0x00, 0x00,
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    0x00, 0x00, 0x00, 0x00, 0x00, 0x00, 0x00, 0x00, 0x00, 0x00, 0x00, 0x00, 0x00, 0x00, 0x00, 0x00};



#define uS_TO_S_FACTOR 1000000ULL
#define TIME_TO_SLEEP 900 // 15 mins 
#define S_TO_MIN_FACTOR 60

int currentState1,
    currentState2,
    temperature, distanceThresh1, distanceThresh2;
unsigned int distanceThresh;
float factoredDis, duration1, duration2, battVoltage, speedOfSound, distance1, distance2;
int sensorValue;
int bat_percentage;
float voltage;

void setup()
{
  Serial.begin(9600);
  WiFi.begin(ssid, password);

  if (!display.begin(SSD1306_SWITCHCAPVCC, SCREEN_ADDRESS))
    {
        Serial.println(F("SSD1306 allocation failed"));
        for (;;)
            ; // Don't proceed, loop forever
    }

  startDisplay();
  delay(2000);
  while (WiFi.status() != WL_CONNECTED)
  {
    delay(1000);
    Serial.println("Connecting to WiFi...");
  }

  Serial.println("Connected to WiFi");
    sensorValue = analogRead(34);
    voltage = adcToVolts(sensorValue);
    bat_percentage = voltToBatteryPercent(voltage, 2.5, 4.2, 0, 100);
    Serial.println("My Computation");
    Serial.print("Value from pin: ");
    Serial.println(sensorValue);
    Serial.print("Voltage read: ");
    Serial.println(voltage);
    Serial.print("Battery Percentage: ");
    Serial.println(bat_percentage);
    Serial.println("");

  dummy();

    


    pinMode(BUZZZER_PIN, OUTPUT);
    pinMode(BUTTON_PIN_1, INPUT_PULLUP);
    pinMode(BUTTON_PIN_2, INPUT_PULLUP);

    
    currentState1 = digitalRead(BUTTON_PIN_1);
    currentState2 = digitalRead(BUTTON_PIN_2);
    
    Serial.print("BTN 1 state: ");
    Serial.print(currentState1);
    Serial.println("");
    Serial.print("BTN 2 state: ");
    Serial.print(currentState2);
    Serial.println("");
    
    if(currentState1 && currentState2 != 0){
        Serial.println("Please close both lids");
        display.clearDisplay();
        display.setTextColor(WHITE);
        display.setTextSize(1);
        display.setCursor(25, 15);
        display.println("Please close both lids");
        display.setTextSize(1);
        display.display();
        soundLeftErr();
        soundRightErr();

        delay(5000);
        goSleep();

    } else if (currentState1 != 0){
        Serial.println("Please close the trashbin lid at left side");
    display.clearDisplay();
    display.setTextColor(WHITE);
    display.setTextSize(1);
    display.setFont(NULL);
    display.setCursor(15, 10);
    display.print("Please Close the");
    display.setCursor(15, 25);
    display.print("trash bin lid at");
    display.setCursor(15, 40);
    display.print("left side");
    display.display();
        soundLeftErr();
        delay(5000);
        goSleep();
    } else if (currentState2 != 0){
        Serial.println("Please close the trashbin lid at right side");
        display.clearDisplay();
    display.setTextColor(WHITE);
    display.setTextSize(1);
    display.setFont(NULL);
    display.setCursor(15, 10);
    display.print("Please Close the");
    display.setCursor(15, 25);
    display.print("trash bin lid at");
    display.setCursor(15, 40);
    display.print("right side");
    display.display();
        soundRightErr();
        delay(5000);
        goSleep();        
    }

}

void loop()
{
  getValue();
  goSleep();


}

void dummy(){

    display.clearDisplay();
    display.setTextColor(WHITE);
    display.setTextSize(1);
    display.setFont(&TomThumb);
    display.setCursor(1, 7);
    display.println("Initialize GSM modem...");
    display.setTextSize(1);
    display.setCursor(1, 15);
    display.println("Status: ");
    display.setCursor(45, 15);
    display.print("Connected");
    display.setCursor(1, 23);
    display.println("Sim:");
    display.setCursor(45, 23);
    display.print("Globe");
    display.setCursor(1, 31);
    display.println("RSSI:");
    display.setCursor(45, 31);
    display.print("-55");
    display.setCursor(1, 39);
    display.println("IP:");
    display.setCursor(45, 39);
    display.print(wifi.localIP());
    display.setCursor(1, 47);
    display.println("BattLvl:");
    display.setCursor(45, 47);
    display.println("30");
    display.setCursor(1, 56);
    display.println("BattVolt:");
    display.setCursor(45, 56);
    display.println(bat_percentage);
    display.display();

    delay(5000);
}

void getValue()
{   
    
      for (uint8_t i = 0; i < 2; i++) { // Loop through each sensor and display results.
    delayMicroseconds(500); // Wait 50ms between pings (about 20 pings/sec). 29ms should be the shortest delay between pings.
    Serial.println(i);

    if(i == 0 ){
        distance1 = sonar[0].ping_cm();
        if(distance1 > 33){
            distance1 = 33;
        }
        Serial.println(distance1);
    }else if(i == 1){
        distance2 = sonar[1].ping_cm();
        if(distance2 > 33){
            distance2 = 33;
        }
        Serial.println(distance2);

    }

    }
        distanceThresh1 = getThreshold(distance1);
        distanceThresh2 = getThreshold(distance2);


    
    delay(5000);
    display.clearDisplay();
    display.drawBitmap(5, 8, trashbin, 128, 64, WHITE);
    display.setFont(NULL);
    display.setTextSize(1);
    display.setTextColor(WHITE);
    display.setCursor(58, 8);
    display.print("Bin 1:");
    display.setCursor(64, 20);
    display.print(distanceThresh1);
    display.setCursor(58, 40);
    display.print("Bin 2:");
    display.setCursor(64, 52);
    display.print(distanceThresh2);
    display.display();
    
    delay(5000);

    display.clearDisplay();
    display.setCursor(22, 23);
    display.print("Sending Values");
    display.setCursor(25, 35);
    display.println("to the server");
    display.display();


    Serial.println("Send data  to [" + server + "].");
    sendPostRequest(bat_percentage, distanceThresh1, distanceThresh2);
}
void initWiFi()
{

  WiFi.begin(ssid, password);
  Serial.print("Connecting to WiFi ..");
  while (WiFi.status() != WL_CONNECTED)
  {
    Serial.print('.');
    delay(1000);
  }
  Serial.println("Wifi Connected");
  Serial.println(WiFi.localIP());
}

void searchWiFi()
{
  Serial.println("scan start");

  // WiFi.scanNetworks will return the number of networks found
  int n = WiFi.scanNetworks();
  Serial.println("scan done");
  if (n == 0)
  {
    Serial.println("no networks found");
  }
  else
  {
    Serial.print(n);
    Serial.println(" networks found");
    for (int i = 0; i < n; ++i)
    {
      // Print SSID and RSSI for each network found
      Serial.print(i + 1);
      Serial.print(": ");
      Serial.print(WiFi.SSID(i));
      Serial.print(" (");
      Serial.print(WiFi.RSSI(i));
      Serial.print(")");
      Serial.println((WiFi.encryptionType(i) == WIFI_AUTH_OPEN) ? " " : "*");
      delay(10);
    }
  }
  Serial.println("");

  // Wait a bit before scanning again
  delay(5000);
}

void sendPostRequest(int batt, int distanceThresh1, int distanceThresh2)
{

  DynamicJsonDocument doc(2048);
  doc["binName"] = "Cloudbin_ITECH3";
  doc["battery3"] = 70;
  doc["bin5"] = distanceThresh1;
  doc["bin6"] = distanceThresh2;

  String json;
  serializeJson(doc, json);

  Serial.println("Sending POST request...");
  http = new HttpClient(wifi, server, port);
  Serial.println("Send POST request...");
  http->beginRequest();
  http->post(path);
  http->sendHeader("Content-Type", "application/json");
  http->sendHeader("Content-Length", json.length());
  // http.sendHeader("X-Custom-Header", "custom-header-value");
  http->beginBody();
  http->print(json);
  http->endRequest();

  // read the status code and body of the response
  int statusCode = http->responseStatusCode();

  if (statusCode == 200)
  {
    String response = http->responseBody();
    Serial.println("Status code: " + String(statusCode));
    Serial.println("Response: " + response);
  }
  else
  {
    Serial.println("Error code: " + String(statusCode));
  }

  http->stop();
}

int getThreshold(float distance)
{    

    int distanceThresh = 0;
    if (distance <= 4)
    {
        distanceThresh = 100;
    }
    else if (distance <= 8)
    {
        distanceThresh = 75;
    }
    else if (distance <= 16)
    {
        distanceThresh = 50;
    }
    else if (distance <= 24)
    {
        distanceThresh = 25;
    }
    else if (distance <= 33)
    {
        distanceThresh = 0;
    }
    
  
    return distanceThresh;  
}

void goSleep(){
    display.clearDisplay();
    display.setTextColor(WHITE);
    display.setTextSize(2);
    display.setFont(&TomThumb);
    display.setCursor(0, 10);
    display.println("Device will sleep");
    display.display();
    delay(2000);
    esp_sleep_enable_timer_wakeup(TIME_TO_SLEEP * uS_TO_S_FACTOR);
    Serial.println("Setup ESP32 to sleep for every " + String(TIME_TO_SLEEP) +
                   " Seconds");
    Serial.println("Going to sleep now");
    display.ssd1306_command(SSD1306_DISPLAYOFF);
    Serial.flush();
    esp_deep_sleep_start();
}

void startDisplay(){
    display.clearDisplay();
    display.setTextColor(WHITE);
    display.setTextSize(2);
    display.setCursor(25, 15);
    display.println("E-Tapon");
    display.setTextSize(1);
    display.setCursor(20, 40);
    display.println("Trash bin 3 & 4");
    display.display();

}

void soundLeftErr(){
  tone(BUZZZER_PIN, 659); // E4
  delay(200);
  tone(BUZZZER_PIN, 700); // F4
  delay(200);
  tone(BUZZZER_PIN, 987.77); //B4
  delay(200);

  noTone(BUZZZER_PIN);
  delay(1500);
}
void soundRightErr(){
  // alert bin 2 
  tone(BUZZZER_PIN, 659); // E4
  delay(200);
  tone(BUZZZER_PIN, 700); // E4
  delay(200);
  tone(BUZZZER_PIN, 523.25); // C4
  delay(200);

  noTone(BUZZZER_PIN);
  delay(1500);
}

int adcAverage(int batteryPin, int read)
{
    int totalADC = 0;
    int averageADC = 0;
    for (int i = 0; i <= read; i++)
    {
        totalADC += analogRead(batteryPin);
    }
    averageADC = totalADC / read;
    return averageADC;
}

float adcToVolts(int batteryPin)
{
    float voltage = ((batteryPin * CONV_FACTOR) / 1000) - 2.30;
    return voltage;
}

float voltToBatteryPercent(float voltage, float in_min, float in_max, float out_min, float out_max)
{
    float batteryPercent = (voltage - in_min) * (out_max - out_min) / (in_max - in_min) + out_min;
    if (batteryPercent >= 100)
    {
        return 100;
    }
    else if (batteryPercent < 0)
    {
        return 0;
    }
    else
    {
        return batteryPercent;
    }
}